## boards/shields/beamboard/Kconfig.defconfig
```kconfig
if SHIELD_BEAMBOARD

config ZMK_KEYBOARD_NAME
    default "beamboard"

config SPI
    default y

config GPIO
    default y

config PINCTRL
    default y

config ZMK_EXT_POWER
    default y

config ZMK_DISPLAY
    select LV_FONT_MONTSERRAT_28

if ZMK_DISPLAY

config LS0XX
    default y

endif # ZMK_DISPLAY

endif
```

## config/west.yml
```yaml
manifest:
  remotes:
    - name: zmkfirmware
      url-base: https://github.com/zmkfirmware
    - name: Nicell
      url-base: https://github.com/Nicell
    # Additional modules containing boards/shields/custom code can be listed here as well
    # See https://docs.zephyrproject.org/3.2.0/develop/west/manifest.html#projects
  projects:
    - name: zmk
      remote: Nicell
      revision: nice-view-custom-screen
      import: app/west.yml
  self:
    path: config
```
