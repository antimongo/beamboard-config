/ {
    default_encoder: encoder_default {
        label = "ENCODER";
        compatible = "alps,ec11";
        status = "okay";
        a-gpios = <&pro_micro 9 (GPIO_ACTIVE_HIGH | GPIO_PULL_UP)>;
        b-gpios = <&pro_micro 8 (GPIO_ACTIVE_HIGH | GPIO_PULL_UP)>;
        resolution = <2>;
        status = "disabled";
    };

    sensors: sensors {
        compatible = "zmk,keymap-sensors";
        sensors = <&default_encoder>;
    };

};